; STANDARD HEADER FILE
	PROCESSOR 	16F876A
;------REGISTER FILES 선언----
; BANK0
INDF	EQU		00H
TMR0	EQU		01H
PCL		EQU		02H
STATUS	EQU		03H
FSR		EQU		04H
PORTA	EQU		05H
PORTB	EQU		06H
PORTC	EQU		07H
PORTD	EQU		08H
PORTE	EQU		09H
PCLATH	EQU 	0AH
INTCON	EQU		0BH
;	BANK	1
OPTIONR	EQU		81H
TRISA	EQU		85H
TRISB	EQU		86H
TRISC	EQU		87H
TRISD	EQU		88H
TRISE	EQU		89H
ADCON1	EQU		9FH
;---STATUS BIT 선언-----
IRP		EQU		7	
RP1		EQU		6
RP0		EQU		5
NOT_TO	EQU		4
NOT_PD	EQU		3
ZF		EQU		2; ZERO FLAG BIT
DC		EQU		1;DIGIT CARRY/BORROW BIT
CF		EQU		0;CARRT/BORROW FLAG BIT
;-----INTCON BITS 선언-----
;-----OPTION BITS 선언-----

W		EQU		B'0';W변수를 0으로 선언
F		EQU		.1; F변수를 1로 선언
SEG1	EQU		21H
DBUF1	EQU		22H
DBUF2	EQU		23H
SECNT	EQU		24H
WOW		EQU		25H
SEC1	EQU		26H
SEC10	EQU		27H
MIN1	EQU		28H
MIN10	EQU		29H
HOUR1	EQU		30H
HOUR2	EQU		31H
DISP	EQU		32H
WOW1	EQU		33H
WOW2	EQU		34H
WOW3	EQU		35H

;MAIN PROGRAM
	ORG 	0000
	CLRF	WOW
	GOTO	START_UP

;INTERRUPT
	ORG		4
	MOVWF	W_TEMP;
	SWAPF	STATUS,W
	MOVWF	STATUS_TEMP
	CALL	WATCH
	BTFSC	DISP,0	; 1이면 DISP, 0이면 NOT DISP
	GOTO	DISP
	SWAPF	STATUS_TEMP,W;
	MOVWF	STATUS
	SWAPF	W_TEMP,F
	SWAPF	W_TEMP,W
	BCF		INTCON,2
	RETFIE	

WATCH
	INCF WOW,F
	MOVF WOW,W
	ANDLW .1
	SUBLW .1
	BTFSC STATUS,ZF
	GOTO WATCH1
	GOTO WATCH2
WATCH1;
	NOP
	RETURN
WATCH2
	INCF SECNT,F
	RETURN

DISP
	INCF	WOW1,F
	BTFSC	WOW1,0
	GOTO	DISP1
	GOTO	DISP2
DISP1
	INCF	WOW2,F
	BTFSC	WOW2,0
	GOTO	DISP3
	GOTO	DISP4
DISP2
	INCF	WOW3,F
	BTFSC	WOW3,0
	GOTO	DISP5
	GOTO	DISP6
DISP3
	MOVF	 MIN1,W
	CALL 	CONV
	BCF		PORTB,1	
	RETURN
DISP4
	MOVF	 MIN10,W
	CALL 	CONV
	BCF		PORTB,2	
	RETURN
DISP5
	MOVF	HOUR1,W
	CALL 	CONV
	BCF		PORTA,2	
	RETURN
DISP6
	MOVF	HOUR10,W
	CALL 	CONV
	BCF		PORTA,3	
	RETURN

;START UP
	START_UP	
	BSF		STATUS,RP0 ;BANK를 1로 변경함
	MOVLW	B'00000111'; PORTA를 DIGITAL I/O로 사용
	MOVWF	ADCON1
	MOVLW	B'01111111'
	MOVWF	OPTIONR
	MOVLW	B'00000000'
	MOVWF	TRISA
	MOVLW	B'00000000'
	MOVWF	TRISC
	MOVLW	B'00111000'
	MOVWF	TRISB
	BCF		STATUS,RP0
;INTERRUPT 시간 설정 2.048ms
	MOVLW	B'00000010'
	MOVWF	OPTIONR
	BCF		STATUS,RP0
	BSF		INTCON,5
	BSF		INTCON,7
	MOVLW	0
	MOVWF	SECNT
	MOVWF	SEC1
	MOVWF	SEC10
	MOVWF	MIN1
	MOVWF	MIN10
	MOVWF	HOUR1
	MOVWF	HOUR10
; START UP END
	
;시간 분 CHECK

MAIN_ST1
	MOVLW	.1
	MOVWF	DISP
	MOVLW	B'00000010'
	MOVWF	OPTIONR
	BCF		STATUS,RP0
	BSF		INTCON,5
	BSF		INTCON,7

M_LOOP
	MOVLW 	.244
	SUBWF 	SECNT,W
	BTFSS	STATUS,ZF
	GOTO	XLOOP
	
CK_LOOP
	CLRF	SECNT
	INCF	SEC1
	MOVLW	.10
	SUBWF	SEC1,W
	BTFSS	STATUS,ZF
	GOTO	XLOOP
	
	CLRF	SEC1
	INCF	SEC10
	MOVLW	.6
	SUBWF	SEC10,W
	BTFSC	STATUS,ZF
	GOTO	MIN
	GOTO	XLOOP
	
MIN
	INCF	MIN1,F
	MOVLW	.10
	SUBWF	MIN1,W
	BTFSS	STATUS,ZF
	GOTO	XLOOP
;10분 
	CLRF	MIN1
	INCF	MIN10
	MOVLW	.6
	SUBWF	MIN10,W
	BTFSC	STATUS,ZF
	GOTO	HOUR
	GOTO	XLOOP

HOUR
	INCF	HOUR1,F
	MOVLW	1
	SUBWF	HOUR10,W
	BTFSC	STATUS,ZF
	GOTO	HOUR2
	GOTO	HOUR1
	
HOUR1;10ALAKS
	MOVLW	.10
	SUBWF	HOUR1,W
	BTFSS	STATUS,ZF
	GOTO	XLOOP
	INCF	HOUR10,F
	GOTO	XLOOP
	
HOUR2;10DLTKD
	MOVLW	.3
	SUBWF	HOUR1,W
	BTFSS	STATUS,ZF
	GOTO	XLOOP
	MOVLW	0
	MOVWF	HOUR10
	MOVWF	HOUR1
	GOTO	XLOOP

XLOOP
	BTFSS	PORTB,3
	GOTO	CHANGE1
	GOTO	M_LOOP


; 시간 설정하기 
CHANGE1
	CALL	DELAY;2초
	BTFSS	PORTB,3
	GOTO	SETTING
	GOTO	MAIN_ST2

SETTING
	MOVLW	0
	MOVWF	DISP
	BTFSS	PORTB,4
	GOTO	DISP7
	BTFSS	PORTB,5
	GOTO	DISP9
DISP7
	MOVLW	1
	ADDWF	MIN1,F
	MOVF	MIN1,W
	MOVLW	.10
	SUBWF	MIN1,W
	CALL	DELAY1
	BTFSS	STATUS,ZF
	GOTO	TWOOF2
DISP8	
	CLRF	MIN1
	INCF	MIN10,F
	MOVF	MIN10,W
	MOVLW	.6
	SUBWF	MIN10,W
	BTFSC	STATUS,ZF
	CLRF	MIN10
	GOTO	TWOOF2
DISP9
	INCF	HOUR1,F
	MOVLW	1
	SUBWF	HOUR10,W
	BTFSC	STATUS,ZF
	GOTO	DISP10
	GOTO	DISP11
	
DISP10
	MOVLW	.10
	SUBWF	HOUR1,W
	BTFSS	STATUS,ZF
	GOTO	TWOOF2
	INCF	HOUR10,F
	GOTO	TWOOF2
DISP11
	MOVLW	.3
	SUBWF	HOUR1,W
	BTFSS	STATUS,ZF
	GOTO	TWOOF2
	MOVLW	0
	MOVWF	HOUR10
	MOVWF	HOUR1
	GOTO	TWOOF2

TWOOF2
	BCF		PORTB,1
	MOVF	MIN1,W
	CALL	CONV
	CALL	DELAY
	BSF		PORTB,1
	BCF		PORTB,2
	MOVF	MIN10,W
	CALL	CONV
	CALL	DELAY
	BSF		PORTB,2
	BCF		PORTA,2
	MOVF	HOUR1,W
	CALL	CONV
	CALL	DELAY
	BSF		PORTA,2
	BCF		PORTA,3
	MOVF	HOUR10,W
	CALL	CONV
	CALL	DELAY
	BSF		PORTA,3
	
	BTFSS	PORTB,3
	GOTO	SETTING	
	GOTO	MAIN_ST3
	




; CONV 7-SEGMENT DATA
CONV	
	ANDLW	0FH
	ADDWF	PCL,F
	GOTO	NUM0 
	GOTO	NUM1
	GOTO	NUM2 
	GOTO	NUM3 
	GOTO	NUM4 
	GOTO	NUM5 
	GOTO	NUM7 
	GOTO	NUM8 
	GOTO	NUM9 
	GOTO	NUM0;10 
	GOTO	NUM0;11
	GOTO	NUM0;12 
	GOTO	NUM0;13
	GOTO	NUM0;14 
	GOTO	NUM0;15 
	RETURN 	

NUM0
	MOVLW	B'11111111'
	MOVWF	PORTC
	BCF		PORTA,1
	BSF		PORTA,0
	RETURN
NUM1
	MOVLW	B'01111000'
	MOVWF	PORTC
	BCF		PORTA,1
	BSF		PORTA,0
	RETURN
NUM2
	MOVLW	B'11011011'
	MOVWF	PORTC
	BSF		PORTA,1
	BSF		PORTA,0
	RETURN
NUM3
	MOVLW	B'11111010'
	MOVWF	PORTC
	BSF		PORTA,1
	BSF		PORTA,0
	RETURN
NUM4
	MOVLW	B'01111100'
	MOVWF	PORTC
	BSF		PORTA,1
	BSF		PORTA,0
	RETURN
NUM5
	MOVLW	B'10111110'
	MOVWF	PORTC
	BSF		PORTA,1
	BSF		PORTA,0
	RETURN
NUM6
	MOVLW	B'10111111'
	MOVWF	PORTC
	BSF		PORTA,1
	BCF		PORTA,0
	RETURN
NUM7
	MOVLW	B'11111100'
	MOVWF	PORTC
	BCF		PORTA,1
	BCF		PORTA,0
	RETURN
NUM8
	MOVLW	B'11111111'
	MOVWF	PORTC
	BSF		PORTA,1
	BCF		PORTA,0
	RETURN
NUM9
	MOVLW	B'11111110'
	MOVWF	PORTC
	BSF		PORTA,1
	BCF		PORTA,0
	RETURN


	END